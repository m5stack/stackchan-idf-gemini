## components/conversation/Kconfig
```kconfig
menu "Stackchan Conversation"

    config STACKCHAN_OPENAI_API_KEY
        string "OpenAI API key"
        default ""
        help
            API key used for the OpenAI Realtime API WebSocket upgrade
            (Authorization: Bearer ...). Leave empty here and set the real
            value in sdkconfig.defaults.local, which is gitignored and chained
            last by the Makefile.

    config STACKCHAN_OPENAI_REALTIME_MODEL
        string "OpenAI Realtime model"
        default "gpt-realtime"

    config STACKCHAN_OPENAI_VOICE
        string "OpenAI Realtime voice"
        default "alloy"

    config STACKCHAN_GEMINI_DEFAULT_MODEL
        string "Default Gemini Live native-audio model"
        default "gemini-3.8-live"
        help
            Used when NVS gemini_model is empty. AI Studio Live API (not
            Vertex). gemini-3.8-live is the current GA low-latency native
            audio model; gemini-2.5-flash-native-audio-preview-12-2025
            remains selectable from the settings page until its shutdown.

    config STACKCHAN_GEMINI_DEFAULT_VOICE
        string "Default Gemini Live prebuilt voice"
        default "Aoede"

    config STACKCHAN_CONV_WS_RX_BUFFER
        int "WebSocket RX reassembly buffer size (bytes)"
        default 131072
        help
            Maximum size of a single reassembled WebSocket text frame. Frames
            larger than this are dropped. OpenAI response.audio.delta frames
            can exceed 40 KB, so this needs generous headroom. Allocated from
            PSRAM.

endmenu
```
